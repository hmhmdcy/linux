## Documentation/devicetree/bindings/media/qcom,sm8150-camss.yaml
```yaml
# SPDX-License-Identifier: (GPL-2.0 OR BSD-2-Clause)
%YAML 1.2
---
$id: http://devicetree.org/schemas/media/qcom,sm8150-camss.yaml#
$schema: http://devicetree.org/meta-schemas/core.yaml#

title: Qualcomm SM8150 CAMSS ISP

maintainers:
  - Robert Foss <robert.foss@linaro.org>

description: |
  SM8150 contains four CSI PHYs and two full image front ends. Board
  supplies and sensor endpoints must be described before enabling CAMSS.
  This local bring-up binding covers the current full-IFE resource subset;
  lite front ends and ICP are not represented.

properties:
  compatible:
    const: qcom,sm8150-camss

  clocks:
    minItems: 33
    maxItems: 33

  clock-names:
    items:
      - const: camnoc_axi
      - const: cpas_ahb
      - const: cphy_rx_src
      - const: csi0
      - const: csi0_src
      - const: csi1
      - const: csi1_src
      - const: csiphy0
      - const: csiphy0_timer
      - const: csiphy0_timer_src
      - const: csiphy1
      - const: csiphy1_timer
      - const: csiphy1_timer_src
      - const: csiphy2
      - const: csiphy2_timer
      - const: csiphy2_timer_src
      - const: csiphy3
      - const: csiphy3_timer
      - const: csiphy3_timer_src
      - const: gcc_camera_ahb
      - const: gcc_camera_axi
      - const: slow_ahb_src
      - const: soc_ahb
      - const: vfe0
      - const: vfe0_axi
      - const: vfe0_cphy_rx
      - const: vfe0_src
      - const: vfe1
      - const: vfe1_axi
      - const: vfe1_cphy_rx
      - const: vfe1_src
      - const: gcc_camera_sf_axi
      - const: camnoc_axi_src

  reg:
    minItems: 10
    maxItems: 10

  reg-names:
    items:
      - const: csid0
      - const: csid1
      - const: csiphy0
      - const: csiphy1
      - const: csiphy2
      - const: csiphy3
      - const: vfe0
      - const: vfe1
      - const: cpas_top
      - const: camnoc

  interrupts:
    minItems: 8
    maxItems: 8

  interrupt-names:
    items:
      - const: csid0
      - const: csid1
      - const: csiphy0
      - const: csiphy1
      - const: csiphy2
      - const: csiphy3
      - const: vfe0
      - const: vfe1

  iommus:
    minItems: 8
    maxItems: 8

  power-domains:
    minItems: 3
    maxItems: 3

  power-domain-names:
    items:
      - const: ife0
      - const: ife1
      - const: top

  interconnects:
    minItems: 4
    maxItems: 4

  interconnect-names:
    items:
      - const: cam_ahb
      - const: cam_hf_0_mnoc
      - const: cam_sf_0_mnoc
      - const: cam_hf_0_camnoc

  memory-region:
    maxItems: 1

  memory-region-names:
    items:
      - const: ife-iova

  vdda-phy-supply:
    description: 1.2V CSIPHY analog supply shared by all four PHYs.


  ports:
    $ref: /schemas/graph.yaml#/properties/ports
    properties:
      port@0:
        $ref: /schemas/graph.yaml#/$defs/port-base
        unevaluatedProperties: false
        properties:
          endpoint:
            $ref: video-interfaces.yaml#
            unevaluatedProperties: false
            properties:
              data-lanes:
                minItems: 1
                maxItems: 4
              bus-type:
                enum: [1, 4]
            allOf:
              - if:
                  properties:
                    bus-type:
                      const: 1
                  required:
                    - bus-type
                then:
                  properties:
                    data-lanes:
                      maxItems: 3
                      uniqueItems: true
                      items:
                        maximum: 2
                    clock-lanes: false
                    lane-polarities: false
                    line-orders:
                      $ref: /schemas/types.yaml#/definitions/uint32-array
                      minItems: 1
                      maxItems: 3
                      items:
                        const: 0
            required:
              - data-lanes
      port@1:
        $ref: /schemas/graph.yaml#/$defs/port-base
        unevaluatedProperties: false
        properties:
          endpoint:
            $ref: video-interfaces.yaml#
            unevaluatedProperties: false
            properties:
              data-lanes:
                minItems: 1
                maxItems: 4
              bus-type:
                enum: [1, 4]
            allOf:
              - if:
                  properties:
                    bus-type:
                      const: 1
                  required:
                    - bus-type
                then:
                  properties:
                    data-lanes:
                      maxItems: 3
                      uniqueItems: true
                      items:
                        maximum: 2
                    clock-lanes: false
                    lane-polarities: false
                    line-orders:
                      $ref: /schemas/types.yaml#/definitions/uint32-array
                      minItems: 1
                      maxItems: 3
                      items:
                        const: 0
            required:
              - data-lanes
      port@2:
        $ref: /schemas/graph.yaml#/$defs/port-base
        unevaluatedProperties: false
        properties:
          endpoint:
            $ref: video-interfaces.yaml#
            unevaluatedProperties: false
            properties:
              data-lanes:
                minItems: 1
                maxItems: 4
              bus-type:
                enum: [1, 4]
            allOf:
              - if:
                  properties:
                    bus-type:
                      const: 1
                  required:
                    - bus-type
                then:
                  properties:
                    data-lanes:
                      maxItems: 3
                      uniqueItems: true
                      items:
                        maximum: 2
                    clock-lanes: false
                    lane-polarities: false
                    line-orders:
                      $ref: /schemas/types.yaml#/definitions/uint32-array
                      minItems: 1
                      maxItems: 3
                      items:
                        const: 0
            required:
              - data-lanes
      port@3:
        $ref: /schemas/graph.yaml#/$defs/port-base
        unevaluatedProperties: false
        properties:
          endpoint:
            $ref: video-interfaces.yaml#
            unevaluatedProperties: false
            properties:
              data-lanes:
                minItems: 1
                maxItems: 4
              bus-type:
                enum: [1, 4]
            allOf:
              - if:
                  properties:
                    bus-type:
                      const: 1
                  required:
                    - bus-type
                then:
                  properties:
                    data-lanes:
                      maxItems: 3
                      uniqueItems: true
                      items:
                        maximum: 2
                    clock-lanes: false
                    lane-polarities: false
                    line-orders:
                      $ref: /schemas/types.yaml#/definitions/uint32-array
                      minItems: 1
                      maxItems: 3
                      items:
                        const: 0
            required:
              - data-lanes

required:
  - compatible
  - clocks
  - clock-names
  - reg
  - reg-names
  - interrupts
  - interrupt-names
  - iommus
  - power-domains
  - power-domain-names
  - interconnects
  - interconnect-names
  - memory-region
  - memory-region-names

allOf:
  - if:
      not:
        properties:
          status:
            const: disabled
        required:
          - status
    then:
      required:
        - vdda-phy-supply

additionalProperties: false
```

## Documentation/devicetree/bindings/power/supply/mps,mp2650.yaml
```yaml
# SPDX-License-Identifier: GPL-2.0-only OR BSD-2-Clause
%YAML 1.2
---
$id: http://devicetree.org/schemas/power/supply/mps,mp2650.yaml#
$schema: http://devicetree.org/meta-schemas/core.yaml#

title: Monolithic Power Systems MP2650 battery charger

maintainers:
  - Samurai Linux port maintainers <samurai-linux@example.com>

description: |
  The MP2650 is an I2C battery charger. The Samurai driver currently exposes
  read-only input voltage, input current, input presence and charging status.
  Registering the device does not reset or configure the charger. Board charge
  policy, input power budgets and protection must be handled separately.

allOf:
  - $ref: power-supply.yaml#

properties:
  compatible:
    const: mps,mp2650

  reg:
    maxItems: 1

required:
  - compatible
  - reg

unevaluatedProperties: false

examples:
  - |
    i2c {
        #address-cells = <1>;
        #size-cells = <0>;

        charger@5c {
            compatible = "mps,mp2650";
            reg = <0x5c>;
        };
    };
```

## drivers/media/platform/qcom/camss/Kconfig
```kconfig
config VIDEO_QCOM_CAMSS
	tristate "Qualcomm V4L2 Camera Subsystem driver"
	depends on V4L_PLATFORM_DRIVERS
	depends on VIDEO_DEV
	depends on (ARCH_QCOM && IOMMU_DMA) || COMPILE_TEST
	select MEDIA_CONTROLLER
	select VIDEO_V4L2_SUBDEV_API
	select VIDEOBUF2_DMA_SG
	select VIDEOBUF2_VMALLOC
	select V4L2_FWNODE
	select V4L2_ISP

config VIDEO_QCOM_CAMSS_ICP_A5_CORE
	tristate
	select DMA_SHARED_BUFFER
	depends on VIDEO_QCOM_CAMSS && IOMMU_DMA && OF && PM_GENERIC_DOMAINS && RESET_CONTROLLER

config VIDEO_QCOM_CAMSS_ICP_A5_MEMORY_TEST
	tristate
	depends on VIDEO_QCOM_CAMSS_ICP_A5_CORE && OF_OVERLAY

config VIDEO_QCOM_CAMSS_ICP_A5_POWER_TEST
	tristate
	depends on VIDEO_QCOM_CAMSS_ICP_A5_CORE && OF_OVERLAY && PM

config VIDEO_QCOM_CAMSS_ICP_A5_BOOT_TEST
	tristate
	depends on VIDEO_QCOM_CAMSS_ICP_A5_CORE && OF_OVERLAY
	select VIDEO_QCOM_CAMSS_ICP_A5_M2M

config VIDEO_QCOM_CAMSS_ICP_A5_M2M
	tristate
	depends on VIDEO_QCOM_CAMSS_ICP_A5_CORE && VIDEO_DEV
	select V4L2_MEM2MEM_DEV
	select VIDEOBUF2_DMA_SG

config VIDEO_QCOM_CAMSS_ICP
	bool "Qualcomm SM8150 ICP/IPE support"
	depends on VIDEO_QCOM_CAMSS && IOMMU_DMA && OF && PM && PM_GENERIC_DOMAINS && RESET_CONTROLLER
	select VIDEO_QCOM_CAMSS_ICP_A5_CORE if VIDEO_QCOM_CAMSS
	select VIDEO_QCOM_CAMSS_ICP_A5_M2M if VIDEO_QCOM_CAMSS
	help
	  Register the SM8150 ICP/IPE platform driver in the CAMSS module.
	  Firmware and frame processing start when V4L2 queues have work.
	  Open streams, exported buffers and retained DMA pin the shared
	  CAMSS/ICP module owner. These static devices do not expose manual
	  driver unbind. Board firmware RAM and IOVA reservations are required.
```
