## Documentation/devicetree/bindings/display/panel/samsung,sofef03f-m.yaml
```yaml
# SPDX-License-Identifier: (GPL-2.0-only OR BSD-2-Clause)
%YAML 1.2
---
$id: http://devicetree.org/schemas/display/panel/samsung,sofef03f-m.yaml#
$schema: http://devicetree.org/meta-schemas/core.yaml#

title: Samsung SOFEF03F_M AMOLED panel

maintainers:
  - hmhmdcy <hmhmdcy@users.noreply.github.com>

description: |
  Samsung SOFEF03F_M 1080x2400 AMOLED panel used in the Realme X2 Pro.
  It uses four DSI lanes in command mode with DSC 1.1, 8 bits per component
  and 8 bits per pixel. Initial support is limited to the stock 60 Hz mode.
  The board switches VCI and VDDD with separate GPIO enables.

allOf:
  - $ref: panel-common.yaml#

properties:
  compatible:
    const: samsung,sofef03f-m
  reg:
    maxItems: 1
  vddio-supply:
    description: 1.8 V panel I/O supply
  vdda-supply:
    description: 3.0 V analog supply shared with the touch controller
  reset-gpios:
    maxItems: 1
  vci-enable-gpios:
    maxItems: 1
    description: Enable the VCI switch, active high
  vddd-enable-gpios:
    maxItems: 1
    description: Enable the VDDD switch, active high
  port: true

required:
  - compatible
  - reg
  - vddio-supply
  - vdda-supply
  - reset-gpios
  - vci-enable-gpios
  - vddd-enable-gpios
  - port

additionalProperties: false
```

## Documentation/devicetree/bindings/media/i2c/onnn,lc898219xi.yaml
```yaml
# SPDX-License-Identifier: (GPL-2.0-only OR BSD-2-Clause)
%YAML 1.2
---
$id: http://devicetree.org/schemas/media/i2c/onnn,lc898219xi.yaml#
$schema: http://devicetree.org/meta-schemas/core.yaml#

title: ON Semiconductor LC898219XI autofocus lens controller

maintainers:
  - Linux Media Mailing List <linux-media@vger.kernel.org>

description:
  LC898219XI is a closed-loop autofocus controller with a 10-bit lens
  position interface controlled over I2C. Module-specific calibration
  and focus limits belong to the camera tuning data.

properties:
  compatible:
    const: onnn,lc898219xi

  reg:
    maxItems: 1

  vdd-supply:
    description: Controller supply, between 2.6 and 3.3 volts.

required:
  - compatible
  - reg
  - vdd-supply

additionalProperties: false

examples:
  - |
    i2c {
        #address-cells = <1>;
        #size-cells = <0>;

        lens@72 {
            compatible = "onnn,lc898219xi";
            reg = <0x72>;
            vdd-supply = <&vdd_lens>;
        };
    };
```

## Documentation/devicetree/bindings/media/i2c/samsung,s5kgw1.yaml
```yaml
# SPDX-License-Identifier: (GPL-2.0-only OR BSD-2-Clause)
%YAML 1.2
---
$id: http://devicetree.org/schemas/media/i2c/samsung,s5kgw1.yaml#
$schema: http://devicetree.org/meta-schemas/core.yaml#

title: Samsung S5KGW1 image sensor

maintainers:
  - Linux Media Mailing List <linux-media@vger.kernel.org>

description:
  Samsung S5KGW1 image sensor controlled over I2C, with a three-trio
  MIPI C-PHY interface and a 19.2 MHz input clock. Autofocus motor
  control and module calibration memories are separate devices.

allOf:
  - $ref: /schemas/media/video-interface-devices.yaml#

properties:
  compatible:
    const: samsung,s5kgw1

  reg:
    maxItems: 1

  clocks:
    maxItems: 1

  reset-gpios:
    description: Active-low sensor reset.
    maxItems: 1

  power-domains:
    maxItems: 1

  vdda-supply:
    description: Analogue voltage supply.

  vddd-supply:
    description: Digital core voltage supply.

  vddio-supply:
    description: Digital I/O voltage supply.

  afvdd-supply:
    description: Optional module autofocus voltage supply.

  port:
    $ref: /schemas/graph.yaml#/$defs/port-base
    additionalProperties: false

    properties:
      endpoint:
        $ref: /schemas/media/video-interfaces.yaml#
        unevaluatedProperties: false

        properties:
          bus-type:
            const: 1

          data-lanes:
            items:
              - const: 0
              - const: 1
              - const: 2

          link-frequencies:
            maxItems: 1

          clock-lanes: false
          lane-polarities: false

        required:
          - bus-type
          - data-lanes
          - link-frequencies

    required:
      - endpoint

required:
  - compatible
  - reg
  - clocks
  - reset-gpios
  - vdda-supply
  - vddd-supply
  - vddio-supply
  - port

unevaluatedProperties: false
...
```

## Documentation/devicetree/bindings/media/i2c/sony,imx319.yaml
```yaml
# SPDX-License-Identifier: (GPL-2.0-only OR BSD-2-Clause)
%YAML 1.2
---
$id: http://devicetree.org/schemas/media/i2c/sony,imx319.yaml#
$schema: http://devicetree.org/meta-schemas/core.yaml#

title: Sony IMX319 CMOS image sensor

maintainers:
  - Linux Media Mailing List <linux-media@vger.kernel.org>

description: |
  Sony IMX319 is a RAW Bayer image sensor with a four-lane CSI-2 interface.
  The endpoint link frequency selects a supported sensor PLL configuration.
  Power sources, voltage constraints and mounting location belong to the board.

allOf:
  - $ref: /schemas/media/video-interface-devices.yaml#

properties:
  compatible:
    const: sony,imx319
  reg:
    maxItems: 1
  clocks:
    maxItems: 1
  assigned-clocks:
    maxItems: 1
  assigned-clock-rates:
    items:
      - const: 19200000
  power-domains:
    maxItems: 1
  reset-gpios:
    maxItems: 1
  vana-supply: true
  vdig-supply: true
  vif-supply: true
  port:
    $ref: /schemas/graph.yaml#/$defs/port-base
    unevaluatedProperties: false
    properties:
      endpoint:
        $ref: /schemas/media/video-interfaces.yaml#
        unevaluatedProperties: false
        properties:
          data-lanes:
            items:
              - const: 1
              - const: 2
              - const: 3
              - const: 4
          link-frequencies:
            minItems: 1
            maxItems: 2
            items:
              enum: [222000000, 482400000]
        required:
          - data-lanes
          - link-frequencies

required:
  - compatible
  - reg
  - clocks
  - reset-gpios
  - vana-supply
  - vdig-supply
  - vif-supply
  - port

unevaluatedProperties: false
```

## Documentation/devicetree/bindings/media/i2c/sony,imx471.yaml
```yaml
# SPDX-License-Identifier: (GPL-2.0-only OR BSD-2-Clause)
%YAML 1.2
---
$id: http://devicetree.org/schemas/media/i2c/sony,imx471.yaml#
$schema: http://devicetree.org/meta-schemas/core.yaml#

title: Sony IMX471 CMOS Image Sensor

maintainers:
  - Danila Tikhonov <danila@mainlining.org>

description:
  The Sony IMX471 is a 16-megapixel image sensor with a 4656 by 3496 active
  pixel array. It is controlled through I2C and transmits image data over
  a two-lane or four-lane MIPI CSI-2 D-PHY interface.

allOf:
  - $ref: /schemas/media/video-interface-devices.yaml#

properties:
  compatible:
    const: sony,imx471

  reg:
    maxItems: 1

  clocks:
    description: External input clock, 19.2 MHz
    maxItems: 1

  power-domains:
    maxItems: 1
    description: Power domain required by the sensor master-clock gate.

  vana-supply:
    description: Analog supply, 2.8 V

  vdig-supply:
    description: Digital core supply, nominally 1.05 V

  vif-supply:
    description: Interface supply, 1.8 V

  reset-gpios:
    description: Active low XCLR reset
    maxItems: 1

  port:
    $ref: /schemas/graph.yaml#/$defs/port-base
    unevaluatedProperties: false

    properties:
      endpoint:
        $ref: /schemas/media/video-interfaces.yaml#
        unevaluatedProperties: false

        properties:
          data-lanes:
            oneOf:
              - items:
                  - const: 1
                  - const: 2
              - items:
                  - const: 1
                  - const: 2
                  - const: 3
                  - const: 4

          link-frequencies: true

        required:
          - data-lanes
          - link-frequencies

    required:
      - endpoint

required:
  - compatible
  - reg
  - clocks
  - vana-supply
  - vdig-supply
  - vif-supply
  - port

unevaluatedProperties: false

examples:
  - |
    #include <dt-bindings/clock/qcom,sm8150-camcc.h>
    #include <dt-bindings/gpio/gpio.h>

    i2c {
        #address-cells = <1>;
        #size-cells = <0>;

        camera@10 {
            compatible = "sony,imx471";
            reg = <0x10>;
            clocks = <&camcc CAM_CC_MCLK2_CLK>;
            assigned-clocks = <&camcc CAM_CC_MCLK2_CLK>;
            assigned-clock-rates = <19200000>;
            vana-supply = <&camera_vana>;
            vdig-supply = <&camera_vdig>;
            vif-supply = <&camera_vif>;
            reset-gpios = <&tlmm 12 GPIO_ACTIVE_LOW>;

            port {
                endpoint {
                    data-lanes = <1 2 3 4>;
                    link-frequencies = /bits/ 64 <200000000>;
                    remote-endpoint = <&csiphy2_ep>;
                };
            };
        };
    };
...
```

## Documentation/devicetree/bindings/media/qcom,sm8150-camss-icp.yaml
```yaml
# SPDX-License-Identifier: (GPL-2.0-only OR BSD-2-Clause)
%YAML 1.2
---
$id: http://devicetree.org/schemas/media/qcom,sm8150-camss-icp.yaml#
$schema: http://devicetree.org/meta-schemas/core.yaml#

title: Qualcomm SM8150 Camera Image Co-Processor

maintainers:
  - Bryan O'Donoghue <bryan.odonoghue@linaro.org>

description: |
  The Cortex-A5 firmware processor controls the BPS and two IPE engines.
  These engines share one DMA domain. The CAMSS supplier owns shared CPAS,
  camera interconnect votes and the top-level camera power resources.
  Firmware RAM is a board reservation. Address-only reserved-memory nodes
  describe the firmware IOVA ABI and do not reserve additional physical RAM.

properties:
  $nodename:
    pattern: '^icp@[0-9a-f]+$'

  compatible:
    const: qcom,sm8150-camss-icp

  reg:
    maxItems: 4

  reg-names:
    items:
      - const: sierra
      - const: bps
      - const: ipe0
      - const: ipe1

  interrupts:
    maxItems: 1

  clocks:
    maxItems: 19

  clock-names:
    items:
      - const: fast_ahb_src
      - const: icp_ahb
      - const: icp_src
      - const: icp
      - const: bps_ahb
      - const: bps_areg
      - const: bps_axi
      - const: bps_src
      - const: bps
      - const: ipe0_ahb
      - const: ipe0_areg
      - const: ipe0_axi
      - const: ipe_src
      - const: ipe0
      - const: ipe1_ahb
      - const: ipe1_areg
      - const: ipe1_axi
      - const: ipe1_src
      - const: ipe1

  power-domains:
    maxItems: 3

  power-domain-names:
    items:
      - const: bps
      - const: ipe0
      - const: ipe1

  resets:
    maxItems: 1

  reset-names:
    const: icp

  qcom,camss:
    $ref: /schemas/types.yaml#/definitions/phandle
    description: CAMSS supplier for CPAS, common clocks and interconnects.

  iommus:
    maxItems: 7
    description: A5, BPS read/write/CDM and IPE read/write/CDM stream groups.

  memory-region:
    maxItems: 6

  memory-region-names:
    items:
      - const: firmware
      - const: firmware-iova
      - const: shared
      - const: heap
      - const: trace
      - const: images

  firmware-name:
    $ref: /schemas/types.yaml#/definitions/string
    pattern: '.+'

  '#address-cells':
    const: 2

  '#size-cells':
    const: 2

required:
  - compatible
  - reg
  - reg-names
  - interrupts
  - clocks
  - clock-names
  - power-domains
  - power-domain-names
  - resets
  - reset-names
  - qcom,camss
  - iommus
  - memory-region
  - memory-region-names

additionalProperties: false
```
